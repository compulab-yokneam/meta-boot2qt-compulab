## conf/layer.conf
```bitbake
# We have a conf and classes directory, add to BBPATH
BBPATH .= ":${LAYERDIR}"

# We have recipes-* directories, add to BBFILES
BBFILES += "${LAYERDIR}/recipes-*/*/*.bb \
            ${LAYERDIR}/recipes-*/*/*.bbappend"

BBFILE_COLLECTIONS += "meta-boot2qt-compulab"
BBFILE_PATTERN_meta-boot2qt-compulab = "^${LAYERDIR}/"
BBFILE_PRIORITY_meta-boot2qt-compulab = "6"

LAYERDEPENDS_meta-boot2qt-compulab = "core"
LAYERSERIES_COMPAT_meta-boot2qt-compulab = "mickledore"
```
